## package/apt/Config.in
```kconfig
config BR2_PACKAGE_APT
	bool "apt"
	select BR2_PACKAGE_GNUTLS
	select BR2_PACKAGE_BZIP2
	select BR2_PACKAGE_LZ4
	select BR2_PACKAGE_ZLIB
	select BR2_PACKAGE_DPKG
	help
	  APT (for Advanced Package Tool) is a set of tools for managing Debian packages, 
	  and therefore the applications installed on your Debian system.

	  https://wiki.debian.org/Apt
	  https://salsa.debian.org/apt-team/apt
```

## package/cdrtools/Config.in.host
```kconfig
config BR2_PACKAGE_CDRTOOLS
	bool "host cdrtools"
	depends on BR2_USE_MMU # fork
	# Needed for libbz
	#select BR2_PACKAGE_BZIP2
	#select BR2_PACKAGE_LIBCAP
	#select BR2_PACKAGE_ZLIB
	help
	  cdrtools is a highly portable CD/DVD/BluRay 
	  command line recording software. It's a set 
	  of command line programs that allows to record 
	  CD/DVD/BluRay media. 
	  
	  http://cdrtools.sourceforge.net/private/cdrecord.html
```

## package/dpkg/Config.in
```kconfig
#comment "opkg needs a toolchain w/ wchar"
#	depends on BR2_USE_MMU
#	depends on !BR2_USE_WCHAR

config BR2_PACKAGE_DPKG
	bool "dpkg"
	depends on BR2_USE_MMU # fork()
	depends on BR2_USE_WCHAR # libarchive
	help
	  Dpkg is a pkgmgr.

	  https://salsa.debian.org/dpkg-team/dpkg
```

## package/glibc/Config.in
```kconfig
if BR2_TOOLCHAIN_BUILDROOT_GLIBC

choice
	prompt "Glibc Version"
	default BR2_GLIBC_VERSION_2_28_X if !BR2_arc
	default BR2_GLIBC_VERSION_ARC if BR2_arc
	help
	  Select the version of glibc you wish to use.

config BR2_GLIBC_VERSION_2_26_X
	bool "glibc 2.26"
	depends on !BR2_arc

config BR2_GLIBC_VERSION_2_26_107
	bool "glibc-2.26-107-g73a92363619e52c458146e903dfb9b1ba823aa40"
	depends on !BR2_arc

config BR2_GLIBC_VERSION_ARC
	bool "arc-2017.09-release"
	depends on BR2_arc
endchoice

config BR2_GLIBC_VERSION
	string
	default "arc-2017.09-release"	if BR2_GLIBC_VERSION_ARC
	default "2.26"		if BR2_GLIBC_VERSION_2_26_X
	default "glibc-2.26-107-g73a92363619e52c458146e903dfb9b1ba823aa40"		if BR2_GLIBC_VERSION_2_26_107

config BR2_PACKAGE_GLIBC
	bool
	default y
	select BR2_PACKAGE_LINUX_HEADERS
	select BR2_TOOLCHAIN_HAS_SSP if BR2_PACKAGE_HOST_BINUTILS_SUPPORTS_CFI
	help
	  https://www.gnu.org/software/libc/
endif
```

## package/vboxguest/Config.in
```kconfig
config BR2_PACKAGE_VBOXGUEST
	bool "vboxguest"
	depends on BR2_LINUX_KERNEL
	depends on BR2_i386
	help
	  VBoxGuest installs the VirtualBox Linux Guest Additions
	  drivers into the target image. 
	
	  http://download.virtualbox.org/virtualbox
```

## support/brosx/configs/brosx_busybox_goldfish_defconfig
```kconfig
BR2_ENABLE_DEBUG=y
# BR2_STRIP_strip is not set
BR2_OPTIMIZE_G=y
BR2_TOOLCHAIN_BUILDROOT_GLIBC=y
BR2_PACKAGE_HOST_LINUX_HEADERS_CUSTOM_3_18=y
BR2_TOOLCHAIN_BUILDROOT_CXX=y
BR2_PACKAGE_HOST_GDB=y
BR2_ROOTFS_DEVICE_CREATION_DYNAMIC_EUDEV=y
BR2_LINUX_KERNEL=y
BR2_LINUX_KERNEL_CUSTOM_GIT=y
BR2_LINUX_KERNEL_CUSTOM_REPO_URL="https://android.googlesource.com/kernel/goldfish"
BR2_LINUX_KERNEL_CUSTOM_REPO_VERSION="android-goldfish-3.18"
BR2_LINUX_KERNEL_DEFCONFIG="i386_ranchu"
BR2_PACKAGE_BUSYBOX_SHOW_OTHERS=y
BR2_PACKAGE_GSTREAMER1=y
BR2_PACKAGE_GST1_PLUGINS_GOOD=y
BR2_PACKAGE_GST1_PLUGINS_GOOD_PLUGIN_FLV=y
BR2_PACKAGE_GST1_PLUGINS_GOOD_PLUGIN_MATROSKA=y
BR2_PACKAGE_BZIP2=y
BR2_PACKAGE_GZIP=y
BR2_PACKAGE_UNZIP=y
BR2_PACKAGE_XZ=y
BR2_PACKAGE_ZIP=y
BR2_PACKAGE_GDB=y
BR2_PACKAGE_STRACE=y
BR2_PACKAGE_E2FSPROGS_RESIZE2FS=y
BR2_PACKAGE_E2TOOLS=y
BR2_PACKAGE_F2FS_TOOLS=y
BR2_PACKAGE_FLASHBENCH=y
BR2_PACKAGE_GLMARK2=y
BR2_PACKAGE_MESA3D_DEMOS=y
BR2_PACKAGE_FBDUMP=y
BR2_PACKAGE_FBGRAB=y
BR2_PACKAGE_FBSET=y
BR2_PACKAGE_FB_TEST_APP=y
BR2_PACKAGE_MESA3D=y
BR2_PACKAGE_MESA3D_GALLIUM_DRIVER_SWRAST=y
BR2_PACKAGE_MESA3D_DRI_DRIVER_SWRAST=y
BR2_PACKAGE_MESA3D_OPENGL_EGL=y
BR2_PACKAGE_MESA3D_OPENGL_ES=y
BR2_PACKAGE_VBOXGUEST=y
BR2_PACKAGE_WESTON=y
BR2_PACKAGE_WESTON_DRM=y
BR2_PACKAGE_WESTON_DEMO_CLIENTS=y
BR2_PACKAGE_XORG7=y
BR2_PACKAGE_XSERVER_XORG_SERVER=y
BR2_PACKAGE_XAPP_OCLOCK=y
BR2_PACKAGE_XAPP_TWM=y
BR2_PACKAGE_XAPP_XCLOCK=y
BR2_PACKAGE_XAPP_XCONSOLE=y
BR2_PACKAGE_XAPP_XDM=y
BR2_PACKAGE_XAPP_XDPYINFO=y
BR2_PACKAGE_XAPP_XDRIINFO=y
BR2_PACKAGE_XAPP_XEDIT=y
BR2_PACKAGE_XAPP_XEV=y
BR2_PACKAGE_XAPP_XEYES=y
BR2_PACKAGE_XAPP_XFD=y
BR2_PACKAGE_XAPP_XINIT=y
BR2_PACKAGE_XAPP_XINPUT=y
BR2_PACKAGE_XAPP_XINPUT_CALIBRATOR=y
BR2_PACKAGE_XAPP_XKBPRINT=y
BR2_PACKAGE_XAPP_XKBUTILS=y
BR2_PACKAGE_XAPP_XLOAD=y
BR2_PACKAGE_XDRIVER_XF86_INPUT_EVDEV=y
BR2_PACKAGE_XDRIVER_XF86_INPUT_LIBINPUT=y
BR2_PACKAGE_XDRIVER_XF86_VIDEO_FBDEV=y
BR2_PACKAGE_XTERM=y
BR2_PACKAGE_XVKBD=y
BR2_PACKAGE_OPENBOX=y
BR2_PACKAGE_EVTEST=y
BR2_PACKAGE_LSHW=y
BR2_PACKAGE_PARTED=y
BR2_PACKAGE_LIBBSD=y
BR2_PACKAGE_LIBSELINUX=y
BR2_PACKAGE_DHCP=y
BR2_PACKAGE_DHCP_CLIENT=y
BR2_PACKAGE_IPUTILS=y
BR2_PACKAGE_OPENSSH=y
BR2_PACKAGE_WGET=y
BR2_PACKAGE_FILE=y
BR2_PACKAGE_ACL=y
BR2_PACKAGE_HTOP=y
BR2_PACKAGE_KMOD_TOOLS=y
BR2_PACKAGE_TAR=y
BR2_PACKAGE_UTIL_LINUX_LIBFDISK=y
BR2_PACKAGE_UTIL_LINUX_FSCK=y
BR2_PACKAGE_UTIL_LINUX_MOUNT=y
BR2_PACKAGE_LESS=y
BR2_PACKAGE_NANO=y
BR2_TARGET_ROOTFS_ISO9660=y
BR2_TARGET_SYSLINUX=y
BR2_PACKAGE_LIBBROSX=y
```

## support/brosx/configs/brosx_busybox_iso_defconfig
```kconfig
#
# rebuild:
# 	make defconfig BR2_DEFCONFIG=support/brosx/configs/brosx_busybox_iso_defconfig
# 
BR2_KERNEL_HEADERS_4_14=y
BR2_LINUX_KERNEL=y
BR2_LINUX_KERNEL_CUSTOM_VERSION=y
BR2_LINUX_KERNEL_CUSTOM_VERSION_VALUE="4.14.10"
BR2_LINUX_KERNEL_USE_ARCH_DEFAULT_CONFIG=y
BR2_PACKAGE_FILE=y
BR2_PACKAGE_HTOP=y
BR2_TARGET_ROOTFS_ISO9660=y
BR2_TARGET_SYSLINUX=y
BR2_PACKAGE_LIBBROSX=y
```

## support/brosx/configs/brosx_systemd_weston_defconfig
```kconfig
BR2_TOOLCHAIN_BUILDROOT_VENDOR="brosx"
BR2_TOOLCHAIN_BUILDROOT_GLIBC=y
BR2_KERNEL_HEADERS_4_14=y
BR2_BINUTILS_VERSION_2_29_X=y
BR2_GCC_VERSION_7_X=y
BR2_TOOLCHAIN_BUILDROOT_CXX=y
BR2_INIT_SYSTEMD=y
BR2_SYSTEM_BIN_SH_BASH=y
BR2_SYSTEM_ENABLE_NLS=y
BR2_LINUX_KERNEL=y
BR2_LINUX_KERNEL_CUSTOM_VERSION=y
BR2_LINUX_KERNEL_CUSTOM_VERSION_VALUE="4.14.10"
BR2_LINUX_KERNEL_USE_CUSTOM_CONFIG=y
BR2_LINUX_KERNEL_CUSTOM_CONFIG_FILE=".config-linux-virt"
BR2_PACKAGE_MESA3D=y
BR2_PACKAGE_MESA3D_GALLIUM_DRIVER_VIRGL=y
BR2_PACKAGE_MESA3D_OPENGL_ES=y
BR2_PACKAGE_WESTON=y
BR2_PACKAGE_WESTON_DRM=y
BR2_PACKAGE_WESTON_DEMO_CLIENTS=y
BR2_PACKAGE_LIBDRM_INSTALL_TESTS=y
BR2_PACKAGE_FILE=y
BR2_PACKAGE_HTOP=y
BR2_TARGET_ROOTFS_ISO9660=y
BR2_TARGET_SYSLINUX=y
BR2_PACKAGE_LIBBROSX=y
```

## support/brosx/libbrosx/Config.in.host
```kconfig
config BR2_PACKAGE_LIBBROSX
	bool "libbrosx"
	#depends on BR2_USE_MMU # fork
	help
	  Simple glue library filling up things from glibc missing in Xcode/clang. 
```
